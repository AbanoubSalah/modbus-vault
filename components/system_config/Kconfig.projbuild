## components/system_config/Kconfig.projbuild
```kconfig
menu "Modbus Vault Settings"
    orsource "../rs485_driver/rs485_driver.Kconfig"
    orsource "../blackbox_logger/blackbox_logger.Kconfig"
    orsource "../mqtt_bridge/mqtt_bridge.Kconfig"
    orsource "../wifi_manager/wifi_manager.Kconfig"
    orsource "../utils/utils.Kconfig"
    orsource "../debug_pins/debug_pins.Kconfig"

    choice SYSTEM_CONFIG_PROV_SEC_VER
        prompt "Protocomm Security Version"
        default SYSTEM_CONFIG_PROV_SEC_VER_1
        depends on WIFI_MODE_USE_BLE_PROVISIONING
        help
            Security version used for provisioning.

        config SYSTEM_CONFIG_PROV_SEC_VER_1
            bool "Version 1"
    endchoice

    config SYSTEM_CONFIG_PROV_POP
        string "Provisioning Proof of Possession (PoP)"
        depends on SYSTEM_CONFIG_PROV_SEC_VER_1
        default "ModbusVault!"
        help
            POP required by the mobile app/provisioning tool.

    config SYSTEM_CONFIG_BLE_DEVICE_NAME
        string "BLE Provisioning Device Name"
        depends on WIFI_MODE_USE_BLE_PROVISIONING
        default "PROV_ESP32S3"
        help
            Broadcast name that the provisioning app will
            look for during Wi-Fi onboarding.

    config SYSTEM_CONFIG_SAVE_PERIOD
        int "Configuration saving period in micro seconds"
        default 30000000
        help
            Settings are saved periodically with period of
            this value in micro seconds.
endmenu
```

## sdkconfig.defaults
```kconfig
CONFIG_IDF_TARGET="esp32-s3"

# --- Flash Config ---
CONFIG_ESPTOOLPY_FLASHSIZE_16MB=y

# --- SPI RAM ---
CONFIG_ESP32S3_SPIRAM_SUPPORT=y

# --- Partition Table ---
CONFIG_PARTITION_TABLE_CUSTOM=y
CONFIG_PARTITION_TABLE_CUSTOM_FILENAME="partition_table/partitionTable.csv"
CONFIG_PARTITION_TABLE_FILENAME="partition_table/partitionTable.csv"

# --- Unit Tests ---
CONFIG_UNITY_ENABLE_64BIT=y
CONFIG_UNITY_ENABLE_COLOR=y
```
